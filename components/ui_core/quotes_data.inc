/* Generated by tools/generate_quotes.py; do not edit. */
{ "My ambition has a loading screen. It has not requested more pixels.", "Arixware" },
{ "I scheduled a breakthrough. The calendar suggested a nap instead.", "Arixware" },
{ "Today I will exceed expectations by correctly identifying tomorrow.", "Arixware" },
{ "My five-year plan currently fits inside a snooze button.", "Arixware" },
{ "The task is small. My ability to postpone it is impressively scalable.", "Arixware" },
{ "I brought a positive attitude. It is waiting for a firmware update.", "Arixware" },
{ "Another meeting could have been a very quiet blinking light.", "Arixware" },
{ "My progress bar is decorative, but the color is reassuring.", "Arixware" },
{ "I have unlimited potential and a very specific charging cable.", "Arixware" },
{ "The deadline is approaching. I am practicing remaining stationary.", "Arixware" },
{ "I optimized my routine by removing the part where things get done.", "Arixware" },
{ "My comfort zone now supports automatic updates.", "Arixware" },
{ "I asked for a sign. The device reported low battery.", "Arixware" },
{ "Today has excellent potential as a cautionary calendar entry.", "Arixware" },
{ "I finished planning the plan. Execution has requested a separate meeting.", "Arixware" },
{ "My productivity graph looks better when the screen is switched off.", "Arixware" },
{ "I can multitask: worry about the task and avoid it simultaneously.", "Arixware" },
{ "The next small step is apparently behind several browser tabs.", "Arixware" },
{ "I am not stuck. I am providing a stable reference point.", "Arixware" },
{ "My motivation is wireless. Something nearby must be interfering.", "Arixware" },
{ "I made room for improvement. It has become the largest room.", "Arixware" },
{ "The alarm believes in me more often than necessary.", "Arixware" },
{ "I set realistic goals. Then I negotiated them down over breakfast.", "Arixware" },
{ "My inner critic has excellent uptime and no useful documentation.", "Arixware" },
{ "I saved my energy for later. Later has not supplied a delivery address.", "Arixware" },
{ "The plan survived first contact with the stationery drawer.", "Arixware" },
{ "I have entered focus mode. Please admire the focused inactivity.", "Arixware" },
{ "Each unfinished task is a reminder that I still have options.", "Arixware" },
{ "I would raise the bar, but someone left another task underneath it.", "Arixware" },
{ "My next great idea is currently being outperformed by a comfortable chair.", "Arixware" },
{ "I checked the clock. It continues to make progress without my help.", "Arixware" },
{ "At least my desk companion has mastered looking busy.", "Arixware" },
